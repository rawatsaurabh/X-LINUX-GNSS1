## X-LINUX-GNSS1_V1.0.0/Recipe/meta-x-linux-gnss/conf/layer.conf
```bitbake
# We have a conf and classes directory, add to BBPATH
BBPATH .= ":${LAYERDIR}"

# We have recipes-* directories, add to BBFILES
BBFILES += "${LAYERDIR}/recipes-*/*/*.bb \
            ${LAYERDIR}/recipes-*/*/*.bbappend"

BBFILE_COLLECTIONS += "meta-x-linux-gnss"
BBFILE_PATTERN_meta-x-linux-gnss = "^${LAYERDIR}/"
BBFILE_PRIORITY_meta-x-linux-gnss = "7"

LAYERDEPENDS_meta-x-linux-gnss = "core"
LAYERSERIES_COMPAT_meta-x-linux-gnss = "dunfell"
```

## X-LINUX-GNSS_V1.0.0/Recipe/meta-gnss/conf/layer.conf
```bitbake
# We have a conf and classes directory, add to BBPATH
BBPATH .= ":${LAYERDIR}"

# We have recipes-* directories, add to BBFILES
BBFILES += "${LAYERDIR}/recipes-*/*/*.bb \
            ${LAYERDIR}/recipes-*/*/*.bbappend"

BBFILE_COLLECTIONS += "meta-gnss"
BBFILE_PATTERN_meta-gnss = "^${LAYERDIR}/"
BBFILE_PRIORITY_meta-gnss = "7"

LAYERDEPENDS_meta-gnss = "core"
LAYERSERIES_COMPAT_meta-gnss = "dunfell"
```

## X-LINUX-GNSS_V1.0.0/Recipe/meta-x-linux-gnss/conf/layer.conf
```bitbake
# We have a conf and classes directory, add to BBPATH
BBPATH .= ":${LAYERDIR}"

# We have recipes-* directories, add to BBFILES
BBFILES += "${LAYERDIR}/recipes-*/*/*.bb \
            ${LAYERDIR}/recipes-*/*/*.bbappend"

BBFILE_COLLECTIONS += "meta-x-linux-gnss1"
BBFILE_PATTERN_meta-x-linux-gnss1 = "^${LAYERDIR}/"
BBFILE_PRIORITY_meta-x-linux-gnss1 = "7"

LAYERDEPENDS_meta-x-linux-gnss1 = "core"
LAYERSERIES_COMPAT_meta-x-linux-gnss1 = "dunfell"
```
